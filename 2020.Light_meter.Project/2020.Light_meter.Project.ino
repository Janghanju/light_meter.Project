// OLED
#include <SPI.h>
#include <Wire.h>
#include <Adafruit_GFX.h>
#include <Adafruit_SSD1306.h>

#define SCREEN_WIDTH 128 // OLED 가로 넓이, 픽셀 사이즈
#define SCREEN_HEIGHT 64 // OLED 세로 넓이, 픽셀 사이즈
 
#define OLED_RESET  -1 // 리셋핀 #(또는 -1 아두이노와 리셋핀을 연결하는 경우)
Adafruit_SSD1306 display(SCREEN_WIDTH, SCREEN_HEIGHT, &Wire, OLED_RESET);

static const unsigned char PROGMEM boot_frame_1[] = {
  0x00, 0x00, 0x00, 0x00, 0x00, 0x00, 0x00, 0x00, 0x00, 0x00, 0x00, 0x00, 0x00, 0x00, 0x00, 0x00, 
  0x00, 0x00, 0x00, 0x00, 0x00, 0x00, 0x00, 0x00, 0x00, 0x00, 0x00, 0x00, 0x00, 0x00, 0x00, 0x00, 
  0x00, 0x00, 0x00, 0x00, 0x00, 0x00, 0x00, 0x00, 0x00, 0x00, 0x00, 0x00, 0x00, 0x00, 0x00, 0x00, 
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  0x00, 0x00, 0x00, 0x00, 0x00, 0x00, 0x00, 0x00, 0x00, 0x00, 0x00, 0x00, 0x00, 0x00, 0x00, 0x00
};

// 3축,가속도 센서
#include <SparkFun_ADXL345.h>
ADXL345 adxl = ADXL345();    // I2C통신이므로 이렇게 수정해야합니다.
int x,y,z;                   // XYZ축을 설정합니다.

// 온습도센서 AHT10
#include <AHT10.h>
uint8_t readStatus = 0;
AHT10 myAHT10(AHT10_ADDRESS_0X38);

// lightmeter
#include <BH1750.h>
BH1750 lightMeter;
#define MODE 0 // 기본 해상도를 변경 가능합니다 0 -> 1 해상도변경시 출력값이 변경됩니다, 출력값에 1/2를 해주시면 정상값이 나옵니다. 

// 초음파센서
#define TRIG 12 //TRIG 핀 설정 (초음파 보내는 핀)
#define ECHO 11 //ECHO 핀 설정 (초음파 받는 핀)

// 버튼
#define BTN_1 4
#define BTN_2 5
#define BTN_3 6
#define BTN_4 7
int btn_num = 0;

// 부저
#define speakerPin 8
int tones[] = {10, 20, 30, 40, 50, 60, 70, 80, 90 ,100};

// SS
float ss[] = { 30, 15, 8, 4 , 2, 1, 1/2, 1/4, 1/8, 1/15,
               1/30, 1/60, 1/125, 1/250, 1/500, 1/1000,
               1/2000, 1/4000, 1/8000, 1/16000};

// F_
float f_[] = { 1.4, 2.0, 2.8, 4.0, 5.6, 8.0, 11.0, 16.0,
               22.0, 32.0 };

// ISO
int iso[] = { 50, 100, 200, 400, 800, 1600, 3200, 6400, 
              12800, 25600, 51200, 102400 };

void setup() {
  Wire.begin(); // I2C통신 초기화
  Serial.begin(9600); //PC모니터로 센서값을 확인하기위해서 시리얼 통신을 정의해줍니다. 

  // I2C통신
  
  // OLED
  if(!display.begin(SSD1306_SWITCHCAPVCC, 0x3C)) { // Address 0x3D for 128x64
  Serial.println(F("SSD1306 Not Connected"));
  for(;;); // SSD1306에 주소할당이 되지 않으면 무한루프
  }
  display.drawBitmap(0, 0, boot_frame_1, 128, 64, 1);
  display.display();
  display.clearDisplay();

  delay(250);
  display.setTextColor(WHITE);

  // lightmeter
  Wire.begin(0x23);
  #if (MODE == 0)
  lightMeter.begin();
  #else
  lightMeter.begin(BH1750_CONTINUOUS_HIGH_RES_MODE_2);
  #endif
  Serial.println("Running...");

  // 정밀 온습도
  while (myAHT10.begin() != true)
  {
    Serial.println(F("AHT10 not connected or fail to load calibration coefficient")); //(F()) save string to flash & keeps dynamic memory free
    delay(100);
  }
  Serial.println(F("AHT10 OK"));
  
  // 3축,가속도 센서
  adxl.powerOn();              // ADXL345을 켭니다.
  adxl.setRangeSetting(4);
  
  // 시그널
  
  // 초음파센서
  pinMode(TRIG, OUTPUT);
  pinMode(ECHO, INPUT);

  // 버튼
  pinMode(BTN_1, INPUT);
  pinMode(BTN_2, INPUT);
  pinMode(BTN_3, INPUT);
  pinMode(BTN_4, INPUT);

}

void loop() {
  
  display.clearDisplay();   // OLED 버퍼 지움
  Wire.begin();

  // 버튼 정의
  int btn_1 = digitalRead(BTN_1);   // 버튼1
  int btn_2 = digitalRead(BTN_2);   // 버튼2
  int btn_3 = digitalRead(BTN_3);   // 버튼3
  int btn_4 = digitalRead(BTN_4);   // 버튼4

  // 버튼 기능
  if (btn_num > 20) {
    btn_num = 0;
  } else if (btn_num < 0) {
    btn_num = 20;
  } else if (btn_1 == 0) {/*
    int i = 0;
    while(1) {
      if (btn_4 == 0) {
        exit(0);
      } else if (btn_num == 0) {
        if (btn_2 == 0) {
          i++;
          // SS
          display.setTextSize(1);
          display.setTextColor(WHITE);
          display.setCursor(20,00);
          display.print("SS ");
          display.print("1/");
          display.print(ss[i],0);
          display.display();
        } else if (btn_3 == 0) {
          i--;
          // SS
          display.setTextSize(1);
          display.setTextColor(WHITE);
          display.setCursor(20,00);
          display.print("SS ");
          display.print("1/");
          display.print(ss[i],0);
          display.display();
        }
          
      } else if (btn_num == 10) {
        if (btn_2 == 0) {
          i++;
          // F_
          display.setTextSize(1);
          display.setTextColor(WHITE);
          display.setCursor(20,10);
          display.print("F ");
          display.print(f_[i],1);
          display.display();
        } else if (btn_3 == 0) {
          i--;
          // F_
          display.setTextSize(1);
          display.setTextColor(WHITE);
          display.setCursor(20,10);
          display.print("F ");
          display.print(f_[i],1);
          display.display();
        }
          
      } else if (btn_num == 20) {
        if (btn_2 == 0) {
          i++;
          // ISO
          display.setTextSize(1);
          display.setTextColor(WHITE);
          display.setCursor(20,20);
          display.print("ISO ");
          display.print(iso[i]);
          display.display();
        } else if (btn_3 == 0) {
          i--;
          // ISO
          display.setTextSize(1);
          display.setTextColor(WHITE);
          display.setCursor(20,20);
          display.print("ISO ");
          display.print(iso[i]);
          display.display();
          
        }
        
      }
      delay(100);
    }*/
  } else if (btn_2 == 0) {
    btn_num = btn_num - 10;
  } else if (btn_3 == 0) {
    btn_num = btn_num + 10;
  }
  delay(100);

  // 그래픽_1
  for (int i=0; i<64; i=i+3) {
    display.setTextSize(1);
    display.setTextColor(WHITE);
    display.setCursor(70,i);
    display.println("|");
  }
  // 그래픽_2
  for (int i=0; i<50; i=i+3) {
    display.setTextSize(1);
    display.setTextColor(WHITE);
    display.setCursor(i+72,40);
    display.println("-");
  }
  // 그래픽_3
  display.setTextSize(1);
  display.setTextColor(WHITE);
  display.setCursor(74,50);
  display.println("I+++I+++I");

  // 그래픽_4
  for (int i=0; i<70; i=i+3) {
    display.setTextSize(1);
    display.setTextColor(WHITE);
    display.setCursor(i,29);
    display.println("-");
  }
  delay(100);
  // 초음파센서
  float duration, distance;

  digitalWrite(TRIG, LOW);
  delayMicroseconds(2);
  digitalWrite(TRIG, HIGH);
  delayMicroseconds(10);
  digitalWrite(TRIG, LOW);
  duration = pulseIn(ECHO, HIGH); //물체에 반사되어돌아온 초음파의 시간을 변수에 저장합니다.

  //34000*초음파가 물체로 부터 반사되어 돌아오는시간 /1000000 / 2(왕복값이아니라 편도값이기때문에 나누기2를 해줍니다.)
  //초음파센서의 거리값이 위 계산값과 동일하게 Cm로 환산되는 계산공식 입니다. 수식이 간단해지도록 적용했습니다.

  distance = ((float)duration * 17)/10000/10; // 물체의 거리 결과값 미터법

  display.setTextSize(1);
  display.setTextColor(WHITE);
  display.setCursor(80,0);
  display.print("FL ");
  if (distance > 4) {
    display.setCursor(100,-1.5);
    display.print("oo");
  } else {
    display.print(distance);
    display.print("m");
  }
  delay(50);
  // 정밀 온습도계
  float humidity = myAHT10.readHumidity();
  float temperature = myAHT10.readTemperature();
  float gamma = log(humidity / 100) + 17.62f * temperature / (243.5f + temperature);
  float dewPoint = 243.5f * gamma / (17.62f - gamma);

  display.setTextSize(1);
  display.setTextColor(WHITE);
  display.setCursor(5,37);
  display.print("TEMP ");
  display.print(temperature,0);
  display.print("`C");

  display.setTextSize(1);
  display.setTextColor(WHITE);
  display.setCursor(5,47);
  display.print("HUMI ");
  display.print(humidity,0);
  display.print(" %");

  display.setTextSize(1);
  display.setTextColor(WHITE);
  display.setCursor(5,57);
  display.print("DEWP ");
  display.print(dewPoint,0);
  display.print("`C");

  delay(100);
  // 3축센서 + 수평계
  adxl.readAccel(&x, &y, &z);   //  x, y를 읽습니다.
  int lv = x;
  if (lv >= -10 && lv <= 10) {
    tone(speakerPin, tone[1]);
    delay(100);
  } else {
    noTone(speakerPin);
  }

  display.setTextSize(1);
  display.setTextColor(WHITE);
  display.setCursor(80,30);
  display.print("LV ");
  display.print(lv);

  if (lv >= -10 && lv <= 10) {
    display.setTextSize(1);
    display.setTextColor(WHITE);
    display.setCursor(98,50);
    display.println("0");
  } else if (lv < -10 && lv >= -20) {
    display.setTextSize(1);
    display.setTextColor(WHITE);
    display.setCursor(92,50);
    display.println("0");
  } else if (lv < -20 && lv >= -30) {
    display.setTextSize(1);
    display.setTextColor(WHITE);
    display.setCursor(86,50);
    display.println("0");
  } else if (lv < -30 && lv >= -40) {
    display.setTextSize(1);
    display.setTextColor(WHITE);
    display.setCursor(80,50);
    display.println("0");
  } else if (lv > 10 && lv <= 20) {
    display.setTextSize(1);
    display.setTextColor(WHITE);
    display.setCursor(105,50);
    display.println("0");
  }else if (lv > 10 && lv <= 20) {
    display.setTextSize(1);
    display.setTextColor(WHITE);
    display.setCursor(109,50);
    display.println("0");
  } else if (lv > 20 && lv <= 30) {
    display.setTextSize(1);
    display.setTextColor(WHITE);
    display.setCursor(111,50);
    display.println("0");
  } else if (lv > 30 && lv <= 40) {
    display.setTextSize(1);
    display.setTextColor(WHITE);
    display.setCursor(117,50);
    display.println("0");
  }
  delay(100);
  // light meter
  #if (MODE == 0)
  uint16_t lux = lightMeter.readLightLevel();
  #else
  uint16_t lux = lightMeter.readLightLevel()/2;
  #endif

  display.setTextSize(1);
  display.setTextColor(WHITE);
  display.setCursor(80,10);
  display.print("LUX ");
  display.print(lux);

  // SS
  display.setTextSize(1);
  display.setTextColor(WHITE);
  display.setCursor(20,00);
  display.print("SS ");
  display.print("1/");
  display.print(ss[0],0);

  // F_
  display.setTextSize(1);
  display.setTextColor(WHITE);
  display.setCursor(20,10);
  display.print("F ");
  display.print(f_[0],1);

  // ISO
  display.setTextSize(1);
  display.setTextColor(WHITE);
  display.setCursor(20,20);
  display.print("ISO ");
  display.print(iso[0]);
  
  // EV
  float Incident_Calibration = 130;
  int EV_Value = log10(lux * iso[0] / Incident_Calibration) / log10(2);

  display.setTextSize(1);
  display.setTextColor(WHITE);
  display.setCursor(80,20);
  display.print("EV ");
  display.print(EV_Value);

  display.setTextSize(1);
  display.setTextColor(WHITE);
  display.setCursor(0,btn_num);
  display.print(" > ");
  
  // 테스트 시리얼 출력

  // 초음파센서
  Serial.print("DIstance : ");
  Serial.print(distance,2); //측정된 물체로부터 거리값(m값)을 보여줍니다.
  Serial.println(" m");
  Serial.println("");

  // 고감도 조도센서
  Serial.print("LUX : ");
  Serial.println(lux);
  Serial.println("");

  // 버튼
  Serial.print("BTN_1: ");
  Serial.println(btn_1);
  Serial.print("BTN_2: ");
  Serial.println(btn_2);
  Serial.print("BTN_3: ");
  Serial.println(btn_3);
  Serial.print("BTN_4: ");
  Serial.println(btn_4);
  Serial.print("btn_num: ");
  Serial.println(btn_num);
  Serial.println("");

  // 정밀 온습도
  Serial.print(F("Temperature: "));
  Serial.print(temperature);
  Serial.println(" ℃");
  Serial.print(F("Humidity: "));
  Serial.print(humidity);
  Serial.println(" %");
  Serial.print(F("DewPoint: "));
  Serial.print(dewPoint);
  Serial.println(" ℃");
  Serial.println("");
  
  // 3축,가속도 센서
  Serial.print("x: ");                 
  Serial.println(x);
  Serial.print("y: ");                 
  Serial.println(y);
  Serial.print("z: ");   
  Serial.println(z);
  Serial.println("");

  // end
  for (long i=0; i < 50000; i++){
    //delay();
  }
  display.display();
}
